## CMakeLists.txt
```
# Top-level CMakeLists.txt for the skeleton application.
#
# Copyright (c) 2017 Open Source Foundries Limited
# Copyright (c) 2018 Foundries.io Ltd
#
# SPDX-License-Identifier: Apache-2.0
#
# This provides a basic application structure suitable for loading by
# mcuboot, which is easy to customize on a per-board basis. It can be
# used as a starting point for new applications.

cmake_minimum_required(VERSION 3.8)

# find_package(Zephyr) in order to load application boilerplate:
# https://docs.zephyrproject.org/latest/develop/application/index.html
find_package(Zephyr REQUIRED HINTS $ENV{ZEPHYR_BASE})
project(NONE)

# This string ends up getting printed in the device console
if (NOT DEFINED FROM_WHO)
  set(FROM_WHO Zephyr)
endif()

target_compile_definitions(app PRIVATE "-DMCUBOOT_HELLO_WORLD_FROM=\"${FROM_WHO}\"")

target_sources(app PRIVATE src/main.c)

target_include_directories(app PUBLIC 
    ${MCUBOOT}/boot/bootutil/include
    ${MCUBOOT}/boot/zephyr/include
)

target_link_libraries(app PUBLIC
    ${MCUBOOTBUILD}/modules/mcuboot/libmcuboot_util.a
    ${MCUBOOTBUILD}/zephyr/libzephyr.a
    ${MCUBOOTBUILD}/zephyr/drivers/flash/libdrivers__flash.a
)
```

## prj.conf
```kconfig
# Print a banner on the UART on startup.
CONFIG_BOOT_BANNER=y

# Enable console and printk()
CONFIG_PRINTK=y
CONFIG_STDOUT_CONSOLE=y

CONFIG_FLASH=y

# Enable Zephyr application to be booted by MCUboot
CONFIG_BOOTLOADER_MCUBOOT=y

# Use the default MCUBoot PEM key file (BOOT_SIGNATURE_KEY_FILE)
CONFIG_MCUBOOT_SIGNATURE_KEY_FILE="bootloader/mcuboot/root-rsa-2048.pem"

CONFIG_COMMON_LIBC_MALLOC_ARENA_SIZE=100240
CONFIG_COMMON_LIBC_MALLOC=y

CONFIG_FPU=y
CONFIG_FP_HARDABI=y
```

## src/main.c
```c
/*
 * Copyright (c) 2017 Linaro, Ltd.
 *
 * SPDX-License-Identifier: Apache-2.0
 */

#include <zephyr/kernel.h>
#include <zephyr/sys/printk.h>

#include "bootutil/bootutil_public.h"

#define SHARED_DATA_TLV_INFO_MAGIC    0x2016

#include <zephyr/devicetree.h>
#define RAM_BASE DT_REG_ADDR(DT_NODELABEL(sram0))
#define RAM_SIZE DT_REG_SIZE(DT_NODELABEL(sram0))
#define MCUBOOT_SHARED_DATA_SIZE     0x100
#define MCUBOOT_SHARED_DATA_BASE     (RAM_BASE + RAM_SIZE - MCUBOOT_SHARED_DATA_SIZE)

void printf_buf_hex(char *title, unsigned char *buf, int len ) {
    printf("\n%s(%d) : ", title, len);
    for (int i =0; i < len; i++) {
     if (i%1024==0) printf("\n");
     printf("%02X", (buf[i]&0xff));
    }
    printf("\n");
}

int main(void)
{
	printk("Hello World from %s on %s!\n",
	       MCUBOOT_HELLO_WORLD_FROM, CONFIG_BOARD);
	printk("Hello World from %s on %s!\n",
	       MCUBOOT_HELLO_WORLD_FROM, CONFIG_BOARD);
	printk("Hello World from %s on %s!\n",
	       MCUBOOT_HELLO_WORLD_FROM, CONFIG_BOARD);

	printf_buf_hex("boot record data", (uint8_t *)MCUBOOT_SHARED_DATA_BASE+8, *((uint16_t *)MCUBOOT_SHARED_DATA_BASE+3));

	boot_set_confirmed();

	return 0;
}
```
